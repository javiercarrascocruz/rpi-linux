## Documentation/devicetree/bindings/hwmon/amphenol,chipcap2.yaml
```yaml
# SPDX-License-Identifier: (GPL-2.0-only OR BSD-2-Clause)
%YAML 1.2
---
$id: http://devicetree.org/schemas/hwmon/amphenol,chipcap2.yaml#
$schema: http://devicetree.org/meta-schemas/core.yaml#

title: ChipCap 2 humidity and temperature iio sensor

maintainers:
  - Javier Carrasco <javier.carrasco.cruz@gmail.com>

description: |
  Relative humidity and temperature sensor on I2C bus.

  Datasheets and application guides are available at:
    https://www.amphenol-sensors.com/en/telaire/humidity/527-humidity-sensors/3095-chipcap-2

properties:
  compatible:
    enum:
      - amphenol,cc2dxx
      - amphenol,cc2dxxs

  reg:
    maxItems: 1

  interrupts:
    description: Data ready signal
    maxItems: 1

  vdd-supply:
    description:
      Controllable supply-regulator to reset the device and enter
      in command mode.


required:
  - compatible
  - reg

additionalProperties: false

examples:
  - |
    #include <dt-bindings/interrupt-controller/irq.h>
    i2c {
        #address-cells = <1>;
        #size-cells = <0>;

        humidity@28 {
            compatible = "amphenol,cc2dxxs";
            reg = <0x28>;
            interrupt-parent = <&gpio>;
            interrupts = <28 IRQ_TYPE_LEVEL_HIGH>;
            vdd-supply = <&reg_vdd>;
        };
    };
```
